# Register Definitions: IP-XACT component
VLNV meklort:<PROJECT>:Register Definitions:1.0

## Address spaces and blocks
NVIC.NVIC: base 0xE000E000, range , width , register
APE.APE: base 0x60200000, range , width 
NVM.NVM: base 0x60240000, range , width , register
APE_PERI.APE_PERI: base 0x60240000, range , width 
RX_PORT0.RX_PORT0: base 0xA0000000, range , width , register
RX_PORT1.RX_PORT1: base 0xA0004000, range , width , register
RX_PORT2.RX_PORT2: base 0xA0008000, range , width , register
RX_PORT3.RX_PORT3: base 0xA000C000, range , width , register
TX_PORT0.TX_PORT0: base 0xA0020000, range , width , register
TX_PORT1.TX_PORT1: base 0xA0022000, range , width , register
TX_PORT2.TX_PORT2: base 0xA0024000, range , width , register
TX_PORT3.TX_PORT3: base 0xA0026000, range , width , register
DEVICE.DEVICE: base 0xA0040000, range , width , register
FILTERS0.FILTERS0: base 0xA0048000, range , width , register
DEVICE1.DEVICE1: base 0xA0050000, range , width , register
FILTERS1.FILTERS1: base 0xA0058000, range , width , register
DEVICE2.DEVICE2: base 0xA0060000, range , width , register
FILTERS2.FILTERS2: base 0xA0068000, range , width , register
DEVICE3.DEVICE3: base 0xA0070000, range , width , register
FILTERS3.FILTERS3: base 0xA0078000, range , width , register
SHM.SHM: base 0x60220000, range , width , register
SHM1.SHM1: base 0x60221000, range , width , register
SHM2.SHM2: base 0x60222000, range , width , register
SHM3.SHM3: base 0x60223000, range , width , register
SHM_CHANNEL0.SHM_CHANNEL0: base 0x60220900, range , width , register
SHM_CHANNEL1.SHM_CHANNEL1: base 0x60220a00, range , width , register
SHM_CHANNEL2.SHM_CHANNEL2: base 0x60220b00, range , width , register
SHM_CHANNEL3.SHM_CHANNEL3: base 0x60220c00, range , width , register

## Registers
Registers are 32-bit, access not given, no defined reset value unless marked. A register's access mark holds for its fields unless they carry their own. Offsets are from the block's base; lines under a group give offsets from that group; [hi:lo] are bit positions; {n}, {i} and the like mark numbered series; 'fields as' and 'values as' point back to an identical list; <NAME> marks a mode.

## RX_PORT0.RX_PORT0 — RX from network port, function 0
Base 0xA0000000
{0x0+4i} in[{i}] (i=0..4095) — This is the memory range into which frames are directed towards the APE by the hardware.
  [31:0] all — All bits
    32=BLOCK_WORDS; 128=BLOCK_BYTES; 0=Control Word; 12=First Payload Word; 2=Additional Payload Word

## TX_PORT0.TX_PORT0 — TX to network port, function 0
Base 0xA0020000
{0x0+4i} out[{i}] (i=0..2047) — This is the memory range into which frames are directed towards the network by the APE firmware.
  [31:0] all — All bits
    32=BLOCK_WORDS; 128=BLOCK_BYTES; 0=Control Word; 3=Frame Len Word; 9=Num Blocks Word; 12=First Payload Word; 2=Additional Payload Word
